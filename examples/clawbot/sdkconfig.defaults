## examples/oneye/bedrail/bedrail-GAW01/sdkconfig.defaults.esp32s3
```kconfig
# =============================================================================
# bedrail-GAW01 ?? ESP32-S3-Zero?4 MB flash / ? PSRAM / ? LCD?
# ?????sdkconfig.defaults ; sdkconfig.defaults.esp32s3 ; sdkconfig.defaults.esp32s3.mem
# =============================================================================

CONFIG_IDF_TARGET="esp32s3"
CONFIG_IDF_TARGET_ESP32S3=y

CONFIG_ESPTOOLPY_FLASHSIZE_4MB=y
CONFIG_ESPTOOLPY_FLASHSIZE="4MB"

CONFIG_PARTITION_TABLE_CUSTOM=y
CONFIG_PARTITION_TABLE_CUSTOM_FILENAME="partitions-4mb.csv"

CONFIG_ESP_TASK_WDT_PANIC=y
CONFIG_ESP_TASK_WDT_TIMEOUT_S=10
```

## examples/oneye/bedrail/bedrail-GAW01/sdkconfig.defaults.esp32s3.mem
```kconfig
# =============================================================================
# bedrail-GAW01 ?? S3-Zero ? PSRAM??? RAM ??????? C6 ? mem ???????????
# =============================================================================

CONFIG_ESP_WIFI_STATIC_RX_BUFFER_NUM=3
CONFIG_ESP_WIFI_DYNAMIC_RX_BUFFER_NUM=6
CONFIG_ESP_WIFI_DYNAMIC_TX_BUFFER_NUM=16
CONFIG_ESP_WIFI_TX_BA_WIN=3
CONFIG_ESP_WIFI_RX_BA_WIN=2
CONFIG_ESP_WIFI_MGMT_SBUF_NUM=6


CONFIG_ONEYE_DEV_SDK_LOG_BUFFER_BYTES=1024
CONFIG_ONEYE_DEV_SDK_TX_QUEUE_BYTES=2048
CONFIG_ONEYE_DEV_SDK_EVENT_OFFLINE_BYTES=2048

# =============================================================================
# 2026-11-18???? ? ?? 6-8 ????????
# ????????????**???**?????? ??**?? BLE ???**?
# ?? T31 ???????????????/ACL/MSYS ??? 1 ??????
# =============================================================================
CONFIG_BT_NIMBLE_MAX_CONNECTIONS=1
CONFIG_NIMBLE_MAX_CONNECTIONS=1
CONFIG_BT_NIMBLE_ACL_BUF_COUNT=4
CONFIG_BT_NIMBLE_MSYS_1_BLOCK_COUNT=6
CONFIG_BT_NIMBLE_MSYS_2_BLOCK_COUNT=6
CONFIG_BT_CTRL_BLE_MAX_ACT=3

# MQTT/TLS????? 118 B?1 KB ???????? 3 KB

# ??????????? cfg ???????
CONFIG_ONEYE_DEV_SDK_EVENT_Q_BYTES=2048
CONFIG_ONEYE_DEV_SDK_EVENT_Q_FRAMES=4
CONFIG_ONEYE_LINK_SCAN_ITVL_MS=200
CONFIG_ONEYE_LINK_SCAN_WINDOW_MS=200
# =============================================================================
# 2026-11-18??imBLE central ????????BLE ?????? T31 ??????+ ??????????????
# ????????/GATT ???????????/RPA ?????????????????????????? ~17 KB
# =============================================================================
CONFIG_BT_NIMBLE_MAX_BONDS=1
CONFIG_BT_NIMBLE_WHITELIST_SIZE=1
CONFIG_BT_NIMBLE_RPA_TIMEOUT=900
CONFIG_BT_NIMBLE_ENABLE_CONN_REATTEMPT=n
CONFIG_BT_NIMBLE_HS_PVCY=n
CONFIG_BT_NIMBLE_MAX_CCCDS=2
CONFIG_BT_NIMBLE_ATT_MAX_PREP_ENTRIES=4
CONFIG_BT_NIMBLE_TRANSPORT_EVT_COUNT=8
CONFIG_BT_NIMBLE_GAP_DEVICE_NAME_MAX_LEN=16
CONFIG_ONEYE_GAW01_TELE_MAX_DEV=8
CONFIG_ONEYE_GAW01_TELE_KEEPALIVE_MS=30000
CONFIG_ONEYE_GAW01_TELE_TEMP_DEADBAND=50
CONFIG_ONEYE_GAW01_TELE_BATT_DEADBAND=2
# CONFIG_ONEYE_GAW01_TELE_SIM is not set
CONFIG_ONEYE_GAW01_TELE_ALWAYS_SCAN=y
```
